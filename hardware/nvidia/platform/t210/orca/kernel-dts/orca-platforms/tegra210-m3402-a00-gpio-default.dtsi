/*
 * Copyright (c) 2017, NVIDIA CORPORATION.  All rights reserved.
 *
 * This program is free software; you can redistribute it and/or modify
 * it under the terms of the GNU General Public License as published by
 * the Free Software Foundation; either version 2 of the License, or
 * (at your option) any later version.
 *
 * This program is distributed in the hope that it will be useful, but WITHOUT
 * ANY WARRANTY; without even the implied warranty of MERCHANTABILITY or
 * FITNESS FOR A PARTICULAR PURPOSE.  See the GNU General Public License for
 * more details.
 *
 * You should have received a copy of the GNU General Public License along
 * with this program; if not, write to the Free Software Foundation, Inc.,
 * 51 Franklin Street, Fifth Floor, Boston, MA  02110-1301, USA.
 */

#include <dt-bindings/gpio/tegra-gpio.h>

/ {
	gpio: gpio@6000d000 {
		gpio-init-names = "default";
		gpio-init-0 = <&gpio_default>;

		gpio_default: default {
			gpio-input = <
				TEGRA_GPIO(M, 0)
				TEGRA_GPIO(M, 3)
				TEGRA_GPIO(P, 0)
				TEGRA_GPIO(P, 1)
				TEGRA_GPIO(P, 3)
				TEGRA_GPIO(P, 2)
				TEGRA_GPIO(X, 6)
				TEGRA_GPIO(U, 2)
				TEGRA_GPIO(K, 0)
				TEGRA_GPIO(K, 1)
				TEGRA_GPIO(K, 2)
				TEGRA_GPIO(K, 3)
				TEGRA_GPIO(K, 4)
				TEGRA_GPIO(K, 5)
				TEGRA_GPIO(K, 6)
				TEGRA_GPIO(K, 7)
				TEGRA_GPIO(L, 0)
				TEGRA_GPIO(L, 1)
				TEGRA_GPIO(H, 5)
				TEGRA_GPIO(I, 6)
				TEGRA_GPIO(CC, 7)
				>;
			gpio-output-low = <
				TEGRA_GPIO(E, 4)
				TEGRA_GPIO(M, 1)
				TEGRA_GPIO(M, 5)
				TEGRA_GPIO(M, 4)
				TEGRA_GPIO(M, 2)
				TEGRA_GPIO(P, 4)
				>;
			gpio-output-high = <
				TEGRA_GPIO(P, 5)
				TEGRA_GPIO(X, 4)
				>;
		};
	};
};
