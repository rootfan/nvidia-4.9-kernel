/*
 * Copyright (c) 2016-2018, NVIDIA CORPORATION.  All rights reserved.
 *
 * This program is free software; you can redistribute it and/or modify it
 * under the terms and conditions of the GNU General Public License,
 * version 2, as published by the Free Software Foundation.
 *
 * This program is distributed in the hope it will be useful, but WITHOUT
 * ANY WARRANTY; without even the implied warranty of MERCHANTABILITY or
 * FITNESS FOR A PARTICULAR PURPOSE.  See the GNU General Public License for
 * more details.
 */

#include "tegra210-pwm-fan-p2530-0930.dtsi"

/ {
	pwm_fan_shared_data: pfsd {
		active_rru = <10240 512 256 256 256 256 256 256 256 256>;
		active_rrd = <10240 512 256 256 256 256 256 256 256 256>;
		pwm_period = <65536>;
		active_pwm_max = <65536>;
	};

	pwm-fan {
		compatible = "pwm-fan";
		status = "okay";
		pwms = <&tegra_pwm 3 65536>;
		shared_data = <&pwm_fan_shared_data>;
		active_pwm = <0 16640 28160 40960 51200 61440 62720 64000 64512 65535>;
	};
};
