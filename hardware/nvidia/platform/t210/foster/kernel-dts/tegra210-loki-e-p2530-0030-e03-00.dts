#include "tegra210-loki-e-p2530-0030-e02-00.dts"

/ {
	nvidia,dtsfilename = __FILE__;

	usb_cd@7009f000 {
		nvidia,dcp-current-limit-ma = <3000>;
	};

	touch-leds-pwm-rework {
		status = "okay";
	};
};
