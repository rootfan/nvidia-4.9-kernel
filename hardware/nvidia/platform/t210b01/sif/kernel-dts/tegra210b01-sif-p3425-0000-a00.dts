/*
 * tegra210b01-sif-p3425-0000-a00.dts
 *
 * Copyright (c) 2018, NVIDIA CORPORATION.  All rights reserved.
 *
 * This program is free software; you can redistribute it and/or modify
 * it under the terms of the GNU General Public License as published by
 * the Free Software Foundation; version 2 of the License.
 *
 * This program is distributed in the hope that it will be useful, but WITHOUT
 * ANY WARRANTY; without even the implied warranty of MERCHANTABILITY or
 * FITNESS FOR A PARTICULAR PURPOSE.  See the GNU General Public License for
 * more details.
 *
 * You should have received a copy of the GNU General Public License along
 * with this program; if not, write to the Free Software Foundation, Inc.,
 * 51 Franklin Street, Fifth Floor, Boston, MA  02110-1301, USA.
 *
 */
#include "tegra210b01-sif-p3425-common.dtsi"
#include "sif-platforms/tegra210b01-sif-pinmux-p3425-0000-a00.dtsi"
#include "sif-platforms/tegra210b01-sif-power-tree-p3425-0000-a00.dtsi"
#include "sif-platforms/tegra210b01-sif-extcon-p3425-0000-a00.dtsi"
#include "sif-platforms/tegra210b01-sif-pcie.dtsi"

/ {
	model = "sif";
	compatible = "nvidia,sif", "nvidia,tegra210b01";
	nvidia,dtsfilename = __FILE__;
	nvidia,dtbbuildtime = __DATE__, __TIME__;

	firmware {
		android {
			compatible = "android,firmware";
			hardware = "sif";
		};
	};
};
